## boards/arm/eyelash_corne_left/Kconfig.eyelash_corne_left
```kconfig
# Copyright (c) 2024 The ZMK Contributors
# SPDX-License-Identifier: MIT

config BOARD_EYELASH_CORNE_LEFT
    select SOC_NRF52840_QIAA
    select ZMK_BOARD_COMPAT if BOARD_EYELASH_CORNE_LEFT_NRF52840_ZMK
```

## boards/arm/eyelash_corne_right/board.yml
```yaml
board:
  name: eyelash_corne_right
  vendor: eyelash
  socs:
    - name: nrf52840
      variants:
        - name: zmk
```

## config/west.yml
```yaml
manifest:
  remotes:
    - name: zmkfirmware
      url-base: https://github.com/zmkfirmware

    - name: qwerty22121998
      url-base: https://github.com/qwerty22121998

  projects:
    - name: zmk
      remote: zmkfirmware
      revision: v0.3-branch
      import: app/west.yml

    - name: eyelash_corne
      url: https://github.com/MrBanh/zmk-new_corne
      revision: main

    - name: nice-view-anim
      remote: qwerty22121998
      revision: main

  self:
    path: config
```
